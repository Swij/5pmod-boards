## boards/arm/5pmod_nrf52840/Kconfig.board
```kconfig
# nRF52840 DK NRF52840 board configuration

# SPDX-License-Identifier: Apache-2.0

config BOARD_5PMOD_NRF52840
	bool "5PMOD nRF52840"
	depends on SOC_NRF52840_QIAA
```

## boards/arm/5pmod_nrf52840/Kconfig.defconfig
```kconfig
# nRF52840 DK NRF52840 board configuration

# SPDX-License-Identifier: Apache-2.0

if BOARD_5PMOD_NRF52840

config BOARD
	default "5pmod_nrf52840"

config BT_CTLR
	default BT

endif # BOARD_5PMOD_NRF52840
```
